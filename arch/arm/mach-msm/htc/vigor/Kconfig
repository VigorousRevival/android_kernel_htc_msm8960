## arch/arm/mach-msm/htc/vigor/Kconfig
```kconfig
config BOARD_HEADER_FILE
	string "HTC board specific header file name"
	default ""

config MACH_VIGOR
	depends on ARCH_MSM8X60
	select MACH_HTC
        select REMOVE_SMI_2X_CLK
	bool "HTC Vigor"
	help
	  Support for the HTC VIGOR device.
```
